// SPDX-License-Identifier: BSD-3-Clause
/*
 * Copyright (c) Qualcomm Technologies, Inc. and/or its subsidiaries.
 */

/dts-v1/;
/plugin/;

#include "art-sde-display-qrd.dtsi"

/ {
	model = "Qualcomm Technologies, Inc. Artl QRD + Fig + ST54L + Harmonium + Pandeiro + 1s battery, Alioth";
	compatible = "qcom,artl-qrd", "qcom,artl", "qcom,artlp-qrd", "qcom,artlp",
			   "qcom,qrd";
	qcom,msm-id = <755 0x10000>;
	qcom,board-id = <0x2000b 0x0>;
};
