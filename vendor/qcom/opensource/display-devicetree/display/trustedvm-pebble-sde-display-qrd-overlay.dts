// SPDX-License-Identifier: BSD-3-Clause
/*Copyright (c) Qualcomm Technologies, Inc. and/or its subsidiaries.
 */

/dts-v1/;
/plugin/;

#include "trustedvm-pebble-sde.dtsi"
#include "trustedvm-pebble-sde-display-qrd.dtsi"

/ {
	model = "Qualcomm Technologies, Inc. Pebble SVM QRD";
	compatible = "qcom,pebble-qrd", "qcom,pebble", "qcom,qrd";
	qcom,msm-id = <735 0x10000>, <735 0x10001>, <741 0x10000>, <741 0x10001>;
	qcom,board-id = <0x1000b 0x0>, <0x2000b 0x0>, <0x1010b 0x0>, <0x1020b 0x0>;
};

