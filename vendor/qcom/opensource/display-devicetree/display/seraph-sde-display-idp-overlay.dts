// SPDX-License-Identifier: BSD-3-Clause
/*
 * Copyright (c) Qualcomm Technologies, Inc. and/or its subsidiaries.
 */

/dts-v1/;
/plugin/;

#include "seraph-sde-display-idp.dtsi"

/ {
	model = "Qualcomm Technologies, Inc. Seraph IDP";
	compatible = "qcom,seraph-idp", "qcom,seraph", "qcom,idp";
	qcom,msm-id = <672 0x10000>, <673 0x10000>, <672 0x10001>, <673 0x10001>;
	qcom,board-id = <0x10022 0>, <0x10022 1>;
};
