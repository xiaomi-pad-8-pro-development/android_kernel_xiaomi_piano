// SPDX-License-Identifier: BSD-3-Clause
/*
 * Copyright (c) Qualcomm Technologies, Inc. and/or its subsidiaries.
 */

&mdss_mdp {
	dsi_nt37802_amoled_video_vhm_i2c_cphy: qcom,mdss_dsi_nt37802_wqhd_plus_vid_vhm_i2c_cphy {
		qcom,mdss-dsi-panel-name = "nt37802 VHM amoled video i2c mode dsi csot panel with DSC";
		qcom,mdss-dsi-panel-type = "dsi_video_mode";
		qcom,mdss-dsi-panel-physical-type = "oled";
		qcom,mdss-dsi-virtual-channel-id = <0>;
		qcom,mdss-dsi-stream = <0>;
		qcom,mdss-dsi-bpp = <24>;
		qcom,mdss-dsi-color-order = "rgb_swap_rgb";
		qcom,mdss-dsi-underflow-color = <0xff>;
		qcom,mdss-dsi-border-color = <0>;
		qcom,dsi-ctrl-num = <0>;
		qcom,dsi-phy-num = <0>;
		qcom,mdss-dsi-traffic-mode = "burst_mode";
		qcom,mdss-dsi-lane-map = "lane_map_0123";
		qcom,mdss-dsi-bllp-eof-power-mode;
		qcom,mdss-dsi-bllp-power-mode;
		qcom,mdss-dsi-lane-0-state;
		qcom,mdss-dsi-lane-1-state;
		qcom,mdss-dsi-lane-2-state;
		qcom,mdss-dsi-dma-trigger = "trigger_sw";
		qcom,mdss-dsi-mdp-trigger = "none";
		qcom,mdss-dsi-reset-sequence =<1 1>, <0 1>, <1 10>;
		qcom,mdss-pan-physical-width-dimension = <701>;
		qcom,mdss-pan-physical-height-dimension = <1558>;
		qcom,mdss-dsi-tx-eot-append;
		qcom,mdss-dsi-panel-dimming-enabled;
		qcom,bl-update-flag = "delay_until_first_frame";
		qcom,panel-cphy-mode;

		qcom_mdss_dsi_display_timings_131: qcom,mdss-dsi-display-timings {
			timing_0_132: timing@0 {
				cell-index = <0>;
				qcom,mdss-dsi-panel-framerate = <120>;
				qcom,mdss-dsi-panel-width = <1440>;
				qcom,mdss-dsi-panel-height = <3200>;
				qcom,mdss-dsi-h-front-porch = <64>;
				qcom,mdss-dsi-h-back-porch = <46>;
				qcom,mdss-dsi-h-pulse-width = <2>;
				qcom,mdss-dsi-v-back-porch = <41>;
				qcom,mdss-dsi-v-front-porch = <21>;
				qcom,mdss-dsi-v-pulse-width = <2>;
				qcom,mdss-dsi-h-sync-skew = <0>;
				qcom,mdss-dsi-h-left-border = <0>;
				qcom,mdss-dsi-h-right-border = <0>;
				qcom,mdss-dsi-v-top-border = <0>;
				qcom,mdss-dsi-v-bottom-border = <0>;
				qcom,mdss-dsi-video-mode;

				qcom,mdss-dsi-on-command = [
					39 00 00 00 00 00 06 F0 55 AA 52 08 08
					39 00 00 00 00 00 17 C1 8E FF EE FF FF
					   EE FF FF EE FF FF EE FF FF EE FF FF
					   FF 7F FF 0E FF
					15 00 00 00 00 00 02 6F 20
					39 00 00 00 00 00 04 C1 3F FD FF
					15 00 00 00 00 00 02 6F 23
					39 00 00 00 00 00 15 C1 0E FF EE FF FF
					   EE FF FF EE FF FF EE FF FF EE FF FF
					   DF 7F 11
					39 00 00 00 00 00 05 2A 00 00 05 9F
					39 00 00 00 00 00 05 2B 00 00 0C 7F
					39 00 00 00 00 00 03 90 03 43
					39 00 00 00 00 00 13 91 AB A8 00 14 C2
					   00 02 68 02 2E 00 0A 05 0E 03 D1 10
					   F0
					15 00 00 00 00 00 02 35 00
					39 00 00 00 00 00 03 51 0F FF
					15 00 00 00 00 00 02 6F 04
					39 00 00 00 00 00 03 51 0F FF
					15 00 00 00 00 00 02 53 20
					15 00 00 00 00 00 02 6F 01
					15 00 00 00 00 00 02 8B 00
					39 00 00 00 00 00 06 F0 55 AA 52 08 04
					15 00 00 00 00 00 02 C0 20
					39 00 00 00 00 00 04 8C 00 00 11
					39 00 00 00 00 00 05 FF AA 55 A5 81
					15 00 00 00 00 00 02 6F 21
					15 00 00 00 00 00 02 F5 03
					15 00 00 00 00 00 02 6F 43
					39 00 00 00 00 00 19 F5 01 02 01 04 00
					   01 02 00 00 00 43 02 00 00 10 00 00
					   10 05 00 11 31 12 11
					15 00 00 00 00 00 02 6F 1D
					39 00 00 00 00 00 04 FB 64 07 80
					15 00 00 00 00 00 02 6F 07
					15 00 00 00 00 00 02 FC 04
					39 00 00 00 00 00 06 F0 55 AA 52 08 01
					15 00 00 00 00 00 02 6F 02
					15 00 00 00 00 00 02 D6 03
					39 00 00 00 00 00 05 FF AA 55 A5 84
					15 00 00 00 00 00 02 6F 9A
					15 00 00 00 00 00 02 F3 0F
					15 00 00 00 00 00 02 6F 02
					15 00 00 00 00 00 02 2F 32
					39 00 00 00 00 00 06 F0 55 AA 52 08 03
					39 00 00 00 00 00 04 C8 01 FF FB
					39 00 00 00 00 00 05 FF AA 55 A5 80
					15 00 00 00 00 00 02 6F 22
					15 00 00 00 00 00 02 FE 06
					15 00 00 00 00 00 02 6D 00
					15 00 00 00 00 00 02 68 20
					39 00 00 00 00 00 06 F0 55 AA 52 08 00
					15 00 00 00 00 00 02 6F 31
					39 00 00 00 00 00 03 C0 01 00
					15 00 00 00 00 00 02 6F 35
					39 00 00 00 00 00 03 C0 23 20
					15 00 00 00 00 00 02 6F 01
					15 00 00 00 00 00 02 5F 40
					39 00 00 00 00 00 06 F0 55 AA 52 08 00
					15 00 00 00 00 00 02 6F 78
					39 00 00 00 00 00 18 B0 11 00 2A 00 C2
					   01 DA 03 7C 05 B1 08 80 0B EE 0F FF
					   05 55 05 56 05 55
					15 00 00 00 00 00 02 6F 6F
					39 00 00 00 00 00 07 B0 02 D0 05 A0 02
					   D0
					39 00 00 00 00 00 06 F0 55 AA 52 08 03
					15 00 00 00 00 00 02 6F 04
					15 00 00 00 00 00 02 C7 FD
					39 00 00 00 00 00 06 F0 55 AA 52 08 00
					15 00 00 00 00 00 02 C7 33
					39 00 00 00 00 00 0C A3 83 01 9B 01 9B
					   02 00 C0 09 09 00
					15 00 00 00 00 00 02 6F 53
					39 00 00 00 00 00 07 A3 02 00 C0 09 09
					   55
					39 00 00 00 00 00 06 F0 55 AA 52 08 00
					39 00 00 00 00 00 11 B5 80 02 38 C8 00
					   00 FF 0C 60 00 00 00 0C 60 00 00
					15 00 00 00 00 00 02 6F 10
					39 00 00 00 00 00 11 B5 00 60 60 60 60
					   60 00 00 11 2B 00 00 00 11 2B 00
					39 00 00 00 00 00 06 F0 55 AA 52 08 00
					15 00 00 00 00 00 02 6F 08
					15 00 00 00 00 00 02 D5 08
					39 00 00 00 00 00 03 D5 4E 10
					15 00 00 00 00 00 02 6F 02
					15 00 00 00 00 00 02 D5 01
					15 00 00 00 00 00 02 6F D9
					39 00 00 00 00 00 03 D5 7F 7F
					15 00 00 00 00 00 02 6F 4E
					15 00 00 00 00 00 02 D5 02
					15 00 00 00 00 00 02 6F 4F
					39 00 00 00 00 00 03 D5 05 07
					15 00 00 00 00 00 02 6F 52
					39 00 00 00 00 00 03 D5 11 02
					15 00 00 00 00 00 02 6F 55
					15 00 00 00 00 00 02 D5 01
					15 00 00 00 00 00 02 6F 56
					15 00 00 00 00 00 02 D5 07
					15 00 00 00 00 00 02 6F 59
					15 00 00 00 00 00 02 D5 70
					15 00 00 00 00 00 02 6F 5C
					15 00 00 00 00 00 02 D5 03
					15 00 00 00 00 00 02 6F 5D
					39 00 00 00 00 00 04 D5 02 03 07
					15 00 00 00 00 00 02 6F 63
					39 00 00 00 00 00 04 D5 08 60 07
					15 00 00 00 00 00 02 6F 69
					15 00 00 00 00 00 02 D5 01
					15 00 00 00 00 00 02 6F 6A
					15 00 00 00 00 00 02 D5 07
					15 00 00 00 00 00 02 6F 70
					15 00 00 00 00 00 02 D5 16
					15 00 00 00 00 00 02 6F B8
					15 00 00 00 00 00 02 D5 02
					15 00 00 00 00 00 02 6F B9
					39 00 00 00 00 00 03 D5 1C 1F
					15 00 00 00 00 00 02 6F BC
					39 00 00 00 00 00 03 D5 5D 02
					15 00 00 00 00 00 02 6F BF
					15 00 00 00 00 00 02 D5 01
					15 00 00 00 00 00 02 6F C0
					15 00 00 00 00 00 02 D5 1F
					15 00 00 00 00 00 02 6F C3
					15 00 00 00 00 00 02 D5 00
					39 00 00 00 00 00 06 F0 55 AA 52 08 01
					15 00 00 00 00 00 02 6F 04
					15 00 00 00 00 00 02 B2 30
					15 00 00 00 00 00 02 6F 25
					15 00 00 00 00 00 02 D8 30
					39 00 00 00 00 00 06 F0 55 AA 52 08 00
					15 00 00 00 00 00 02 6F D1
					15 00 00 00 00 00 02 D5 13
					15 00 00 00 00 00 02 6F D2
					15 00 00 00 00 00 02 D5 56
					15 00 00 00 00 00 02 6F 03
					15 00 00 00 00 00 02 B5 35
					39 00 00 00 00 00 06 F0 55 AA 52 08 01
					15 00 00 00 00 00 02 6F 04
					15 00 00 00 00 00 02 B2 20
					39 00 00 00 00 00 05 3B 00 2B 00 15
					15 00 00 00 00 00 02 6F 04
					39 00 00 00 00 00 05 3B 00 2B 04 55
					15 00 00 00 00 00 02 6F 08
					39 00 00 00 00 00 05 3B 00 2B 00 15
					15 00 00 00 00 00 02 6F 0C
					39 00 00 00 00 00 05 3B 00 2B 00 15
					15 00 00 00 00 00 02 6F 10
					39 00 00 00 00 00 05 3B 00 2B 04 55
					39 00 00 00 00 00 06 F0 55 AA 52 08 00
					15 00 00 00 00 00 02 6F 24
					39 00 00 00 00 00 07 C9 0C C0 11 00 0C
					   C0
					39 00 00 00 00 00 04 8D 00 20 00
					15 00 00 00 00 00 02 6F 8A
					15 00 00 00 00 00 02 44 19
					39 00 00 00 00 00 06 F0 55 AA 52 08 00
					15 00 00 00 00 00 02 6F 14
					39 00 00 00 00 00 04 35 6A 77 7D
					15 00 00 00 00 00 02 6F 17
					39 00 00 00 00 00 04 35 6A 77 7D
					15 00 00 00 00 00 02 6F 1A
					39 00 00 00 00 00 04 35 6A 77 7D
					15 00 00 00 00 00 02 6F 1D
					39 00 00 00 00 00 04 35 6A 77 7D
					15 00 00 00 00 00 02 6F 26
					39 00 00 00 00 00 03 44 00 78
					15 00 00 00 00 00 02 6F 28
					39 00 00 00 00 00 03 44 00 78
					15 00 00 00 00 00 02 6F 42
					39 00 00 00 00 00 03 44 00 78
					15 00 00 00 00 00 02 6F 64
					39 00 00 00 00 00 03 44 00 78
					15 00 00 00 00 00 02 8C 02
					15 00 00 00 00 00 02 6F 2A
					15 00 00 00 00 00 02 44 1A
					15 00 00 00 00 00 02 6F 2B
					39 00 00 00 00 00 03 44 0B 40
					15 00 00 00 00 00 02 6F 02
					15 00 00 00 00 00 02 35 18
					39 00 00 00 00 00 06 F0 55 AA 52 08 00
					15 00 00 00 00 00 02 6F 04
					15 00 00 00 00 00 02 BA 00
					15 00 00 00 00 00 02 6F 0C
					15 00 00 00 00 00 02 35 00
					39 00 00 00 00 00 04 2F 30 05 30
					39 00 00 00 00 00 06 F0 55 AA 52 08 00
					15 00 00 00 00 00 02 6F 35
					15 00 00 00 00 00 02 B1 10
					39 00 00 00 00 00 06 F0 55 AA 52 08 00
					15 00 00 00 00 00 02 6F DD
					15 00 00 00 00 00 02 BA 80
					39 00 00 00 00 00 06 F0 55 AA 52 08 08
					15 00 00 00 00 00 02 6F 02
					15 00 00 00 00 00 02 E0 81
					39 00 00 00 00 00 06 F0 55 AA 52 08 00
					15 00 00 00 00 00 02 6F E2
					15 00 00 00 00 00 02 BA 08
					39 00 00 00 00 00 05 FF AA 55 A5 81
					15 00 00 00 00 00 02 6F 00
					15 00 00 00 00 00 02 FB 10
					39 00 00 00 00 00 05 FF AA 55 A5 81
					15 00 00 00 00 00 02 6F 1C
					15 00 00 00 00 00 02 FB 10
					39 00 00 00 00 00 06 F0 55 AA 52 08 00
					39 00 00 00 00 00 05 BE 47 4A 49 49
					15 00 00 00 00 00 02 6F 11
					15 00 00 00 00 00 02 BE 5A
					39 00 00 00 00 00 05 FF AA 55 A5 81
					15 00 00 00 00 00 02 6F 0C
					15 00 00 00 00 00 02 F9 0D
					15 00 00 00 00 00 02 6F 01
					15 00 00 00 00 00 02 8D 40
					15 00 00 00 00 00 02 71 01
					15 00 00 00 00 00 02 18 00
					15 00 00 00 00 00 02 6D 07
					39 00 00 00 00 00 06 F0 55 AA 52 08 03
					15 00 00 00 00 00 02 6F 06
					15 00 00 00 00 00 02 BA 01
					05 00 00 00 78 00 01 11
					05 00 00 00 00 00 01 29
					0a 01 00 00 00 00 80 12 00 00 89 30 80
					   0c 80 05 a0 00 14 02 d0 02 d0 02 00
					   02 86 00 20 02 15 00 0a 00 0d 05 7a
					   03 d1 18 00 10 f0 03 0c 20 00 06 0b
					   0b 33 0e 1c 2a 38 46 54 62 69 70 77
					   79 7b 7d 7e 01 02 01 00 09 40 09 be
					   19 fc 19 fa 19 f8 1a 38 1a 78 1a b6
					   2a b6 2a f4 2a f4 4b 34 63 74 74 00
					   00 00 00 00 00 00 00 00 00 00 00 00
					   00 00 00 00 00 00 00 00 00 00 00 00
					   00 00 00 00 00 00 00 00 00 00 00 00
					   00 00
				];

				qcom,mdss-dsi-off-command = [
					05 00 00 00 1E 00 01 28
					05 00 00 00 78 00 01 10
				];

				qcom,mdss-dsi-sticky_still_en-command = [
					15 00 00 00 00 00 02 18 01
				];

				qcom,mdss-dsi-sticky_still_disable-command = [
					15 00 00 00 00 00 02 18 00
				];

				qcom,mdss-dsi-freq-step-pattern1-command = [
					//No Cmd Setting
					39 01 00 00 00 00 06 F0 55 AA 52 08 00
				];

				qcom,mdss-dsi-freq-step-pattern2-command = [
					//No Cmd Setting
					39 01 00 00 00 00 06 F0 55 AA 52 08 00
				];

				qcom,mdss-dsi-freq-step-pattern3-command = [
					//No Cmd Setting
					39 01 00 00 00 00 06 F0 55 AA 52 08 00
				];

				qcom,mdss-dsi-freq-step-pattern4-command = [
					//No Cmd Setting
					39 01 00 00 00 00 06 F0 55 AA 52 08 00
				];

				qcom,mdss-dsi-qsync-freq-pattren-needs-selfrefresh =
					<1 1 1 1>;
				qcom,mdss-dsi-qsync-freq-step-sequence-interval =
					<0 120000 1>, <0 60000 1>, <0 30000 1>,
					<1 120000 1>;
				qcom,mdss-dsi-qsync-freq-step-sequence =
					<60000 1>,
					<30000 1>,
					<24000 1>,
					<10000 1>;
				qcom,mdss-dsi-on-command-state = "dsi_lp_mode";
				qcom,mdss-dsi-off-command-state = "dsi_hs_mode";
				qcom,mdss-dsi-sticky_still_en-command-state = "dsi_hs_mode";
				qcom,mdss-dsi-sticky_still_disable-command-state = "dsi_hs_mode";
				qcom,mdss-dsi-freq-step-pattern1-command-state = "dsi_hs_mode";
				qcom,mdss-dsi-freq-step-pattern2-command-state = "dsi_hs_mode";
				qcom,mdss-dsi-freq-step-pattern3-command-state = "dsi_hs_mode";
				qcom,mdss-dsi-freq-step-pattern4-command-state = "dsi_hs_mode";

				qcom,compression-mode = "dsc";
				qcom,mdss-dsc-version = <0x12>;
				qcom,mdss-dsc-scr-version = <0x0>;
				qcom,mdss-dsc-slice-height = <20>;
				qcom,mdss-dsc-slice-width = <720>;
				qcom,mdss-dsc-slice-per-pkt = <2>;
				qcom,mdss-dsc-bit-per-component = <8>;
				qcom,mdss-dsc-bit-per-pixel = <8>;
				qcom,mdss-dsc-block-prediction-enable;
			};
		};
	};
};
