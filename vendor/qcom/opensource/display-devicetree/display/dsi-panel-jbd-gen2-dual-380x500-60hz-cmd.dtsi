// SPDX-License-Identifier: BSD-3-Clause
/*
 * Copyright (c) Qualcomm Technologies, Inc. and/or its subsidiaries.
 */

&mdss_mdp {
	dsi_jbd_gen2_dual_380x500_60hz_cmd: qcom,mdss_dsi_jbd_gen2_dual_380x500_60hz_cmd {
		qcom,mdss-dsi-panel-name =
			"JBD uLED cmd mode dsi i2c panel without DSC";
		qcom,mdss-dsi-panel-type = "dsi_cmd_mode";
		qcom,mdss-dsi-panel-physical-type = "oled";
		qcom,mdss-dsi-virtual-channel-id = <0>;
		qcom,mdss-dsi-stream = <0>;
		qcom,mdss-dsi-bpp = <24>;
		qcom,mdss-dsi-border-color = <0>;
		qcom,dsi-ctrl-num = <0 1>;
		qcom,dsi-phy-num = <0 1>;
		qcom,mdss-dsi-traffic-mode = "non_burst_sync_event";
		qcom,mdss-dsi-bllp-eof-power-mode;
		qcom,mdss-dsi-bllp-power-mode;
		qcom,mdss-dsi-lane-0-state;
		qcom,mdss-dsi-dma-trigger = "trigger_sw";
		qcom,mdss-dsi-mdp-trigger = "none";
		qcom,mdss-dsi-reset-sequence = <1 10>, <0 10>, <1 20>;

		qcom,mdss-dsi-te-pin-select = <1>;
		qcom,mdss-dsi-wr-mem-start = <0x2c>;
		qcom,mdss-dsi-wr-mem-continue = <0x3c>;
		qcom,mdss-dsi-te-dcs-command = <1>;
		qcom,mdss-dsi-te-check-enable;
		qcom,mdss-dsi-te-using-wd;
		qcom,mdss-dsi-te-using-te-pin;

		qcom,mdss-panel-i2c-on-command = [
			/*
			 * byte 0: I2C slave address
			 * byte 1: Delay in mili seconds
			 * byte 2: Payload length in bytes
			 * byte 3-5: Register Address ADR[23:16] ADR[15:8] ADR[7:0]
			 * byte 6 and beyond: WDT[7:0] WDT[15:8] ...
			 */
			/* Enable i2c */
			58 00 05 20 0e 04 02 00

			/* Interrupt mask registers */
			58 00 07 20 10 44 ff ff 00 00
			58 00 07 20 10 4c ff ff 00 00
			58 00 07 20 10 54 ff ff 00 00
			58 00 07 20 10 5c ff ff 00 00
			58 00 07 20 10 64 ff ff 00 00
			58 00 07 20 10 6c ff ff 00 00
			58 00 05 20 0b 0a ff ff

			/* Mipi initialization */
			/* Enable dsi */
			58 00 07 20 10 04 01 00 00 00

			/* Enable eotp feature */
			/* Skip this reg if the feature is not enabled in host */
			58 00 07 20 10 0c 07 00 00 00

			/* Cmd mode valid virtual channel */
			58 00 07 20 10 28 0f 00 00 00

			/* Internal clk dividers */
			58 00 07 20 10 2c 08 00 00 00

			/* Enable dphy */
			58 00 07 20 20 00 7d 00 00 00

			/* THS-Settle */
			58 00 07 20 21 e0 0e 00 00 00

			/* Enable continuous clock mode */
			58 00 07 20 21 28 3f 00 00 00

			/* Enable dphy trigger feature */
			58 00 07 20 21 f4 27 00 00 00

			/* Panel initialization */
			/* Pixel current */
			58 00 05 20 01 00 32 00

			/* Sf bit 10 with refresh frequency 240Hz */
			58 00 05 20 0a 00 0c 00

			/* Enable panel display */
			58 00 05 20 0a 02 01 00

			/* Enable panel data load */
			58 00 05 20 0a 04 02 00

			/* Luminance */
			58 00 05 20 0a 14 88 13

			/* X-axis start coordinate */
			58 00 05 20 0a 1c 00 00

			/* X-axis end coordinate */
			58 00 05 20 0a 1e 7b 01

			/* Y-axis start coordinate */
			58 00 05 20 0a 20 00 00

			/* Y-axis end coordinate */
			58 00 05 20 0a 22 f3 01

			/* bit[4:0] X-axis offset, bit[12:8] Y-axis offset */
			58 00 05 20 0a 24 06 0a

			/* 1'b0: cmd mode, 1'b1: video mode */
			58 00 05 20 0b 06 00 00

			/* Algorithm initialization */
			/* Demura setting */
			58 00 05 20 0d 30 02 00
			58 00 05 20 0d 34 a1 80
			58 00 05 20 02 04 ff 03

			/* Load gamma and demura data */
			/* Gamma enable，disable: 0000 */
			58 00 05 20 02 00 00 01

			/* Demura enable，disable: 0000 */
			58 00 05 20 02 02 00 01

			/* Frame buffer write with mipi cmd mode */
			/* Self refresh enable + frame sync signal */
			58 00 05 20 0a 04 0f 00
		];

		qcom,mdss-dsi-display-timings {
			timing@0 {
				cell-index = <0>;
				qcom,mdss-dsi-panel-framerate = <60>;
				qcom,mdss-dsi-panel-width = <380>;
				qcom,mdss-dsi-panel-height = <500>;
				qcom,mdss-dsi-h-front-porch = <20>;
				qcom,mdss-dsi-h-back-porch = <20>;
				qcom,mdss-dsi-h-pulse-width = <4>;
				qcom,mdss-dsi-h-sync-skew = <0>;
				qcom,mdss-dsi-v-back-porch = <2>;
				qcom,mdss-dsi-v-front-porch = <20>;
				qcom,mdss-dsi-v-pulse-width = <2>;
				qcom,mdss-dsi-h-left-border = <0>;
				qcom,mdss-dsi-h-right-border = <0>;
				qcom,mdss-dsi-v-top-border = <0>;
				qcom,mdss-dsi-v-bottom-border = <0>;
				qcom,mdss-dsi-h-sync-pulse = <0>;

				qcom,mdss-dsi-on-command = [
					29 01 00 00 00 00 04 FF 03 03 00
				];
				qcom,mdss-dsi-on-command-state = "dsi_lp_mode";

				qcom,mdss-dsi-off-command = [
					29 01 00 00 00 00 04 FF 03 03 00
				];
				qcom,mdss-dsi-off-command-state = "dsi_hs_mode";
			};
		};
	};
};
