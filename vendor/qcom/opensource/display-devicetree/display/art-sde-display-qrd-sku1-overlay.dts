// SPDX-License-Identifier: BSD-3-Clause
/*
 * Copyright (c) Qualcomm Technologies, Inc. and/or its subsidiaries.
 */

/dts-v1/;
/plugin/;

#include "art-sde-display-qrd.dtsi"

/ {
	model = "Qualcomm Technologies, Inc. Art QRD + Fig + ST54L + QMP1000 + Pandeiro + 2s battery + Pictor";
	compatible = "qcom,art-qrd", "qcom,art", "qcom,artp-qrd", "qcom,artp",
			   "qcom,qrd";
	qcom,msm-id = <707 0x10000>, <707 0x20000>, <755 0x10000>, <755 0x20000>,
		<708 0x10000>, <708 0x20000>;
	qcom,board-id = <0x1000b 0>, <0x1001000b 0>;
};

&sde_dsi {
	exvdd-supply = <&display_panel_vdd>;
	qcom,dsi-default-panel = <&dsi_nt37802_amoled_cmd_i2c_cphy>;
};

&sde_dp {
	/delete-property/ qcom,dp-aux-switch;
};
