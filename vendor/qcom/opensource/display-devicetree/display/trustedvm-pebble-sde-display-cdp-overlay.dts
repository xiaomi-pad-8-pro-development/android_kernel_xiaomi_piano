// SPDX-License-Identifier: BSD-3-Clause
/*
 * Copyright (c) Qualcomm Technologies, Inc. and/or its subsidiaries.
 */
/dts-v1/;
/plugin/;

#include "trustedvm-pebble-sde.dtsi"
#include "trustedvm-pebble-sde-display-cdp.dtsi"

/ {
	model = "Qualcomm Technologies, Inc. Pebble SVM CDP";
	compatible = "qcom,pebble-cdp", "qcom,pebble", "qcom,cdp";
	qcom,msm-id = <735 0x10000>, <735 0x10001>, <741 0x10000>, <741 0x10001>;
	qcom,board-id = <0x10001 0x0>, <0x10101 0x0>, <0x30001 0x0>, <0x40001 0x0>, <0x20001 0x0>;
};
