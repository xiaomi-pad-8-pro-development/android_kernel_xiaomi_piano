// SPDX-License-Identifier: BSD-3-Clause
/*
 * Copyright (c) Qualcomm Technologies, Inc. and/or its subsidiaries.
 */

/dts-v1/;
/plugin/;

#include "pikachu-sde.dtsi"

/ {
	model = "Qualcomm Technologies, Inc. Pikachu SoC";
	compatible = "qcom,pikachu";
	qcom,msm-id = <736 0x10000>;
	qcom,board-id = <0 0>;
};
