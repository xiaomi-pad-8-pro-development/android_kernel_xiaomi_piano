// SPDX-License-Identifier: BSD-3-Clause
/*
 * Copyright (c) Qualcomm Technologies, Inc. and/or its subsidiaries.
 */

/dts-v1/;
/plugin/;

#include "monaco-sde.dtsi"

/{
	qcom,msm-id = <486 0x10000>, <517 0x10000>;
	qcom,board-id = <0 0>;
};
