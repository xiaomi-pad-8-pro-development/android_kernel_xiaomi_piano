// SPDX-License-Identifier: BSD-3-Clause
/*
 * Copyright (c) Qualcomm Technologies, Inc. and/or its subsidiaries.
 */
/dts-v1/;
/plugin/;

#include "trustedvm-pebble-sde.dtsi"
#include "trustedvm-pebble-sde-display-mtp.dtsi"

/ {
	model = "Qualcomm Technologies, Inc. Pebble SVM MTP";
	compatible = "qcom,pebble-mtp", "qcom,pebble", "qcom,mtp";
	qcom,msm-id = <735 0x10000>, <735 0x10001>, <741 0x10000>, <741 0x10001>;
	qcom,board-id = <0x10008 0x0>, <0x10108 0x0>, <0x60108 0x0>, <0x10308 0x0>,
			<0x20008 0x0>, <0x20108 0x0>, <0x30108 0x0>, <0x30008 0x0>,
			<0x50008 0x0>, <0x60008 0x0>, <0x10208 0x0>, <0x10408 0x0>,
			<0x20208 0x0>, <0x20308 0x0>;
};
