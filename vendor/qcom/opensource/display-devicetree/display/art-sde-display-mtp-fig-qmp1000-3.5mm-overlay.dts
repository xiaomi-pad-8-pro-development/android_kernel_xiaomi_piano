// SPDX-License-Identifier: BSD-3-Clause
/*
 * Copyright (c) Qualcomm Technologies, Inc. and/or its subsidiaries.
 */

/dts-v1/;
/plugin/;

#include "art-sde-display-mtp.dtsi"

/ {
	model = "Qualcomm Technologies, Inc. Art MTP + Fig + SN300U + QMP1000 + 3.5mm jack";
	compatible = "qcom,art-mtp", "qcom,art", "qcom,artp-mtp", "qcom,artp",
			"qcom,mtp";
	qcom,msm-id = <707 0x10000>, <707 0x20000>, <708 0x10000>, <708 0x20000>;
	qcom,board-id = <0x10208 0>, <0x10010208 0>;
};
