// SPDX-License-Identifier: BSD-3-Clause
/*
 * Copyright (c) Qualcomm Technologies, Inc. and/or its subsidiaries.
 */

/dts-v1/;
/plugin/;

#include "artl-sde.dtsi"

/ {
	model = "Qualcomm Technologies, Inc. Artl";
	compatible = "qcom,artl";
	qcom,msm-id = <755 0x10000>;
	qcom,board-id = <0 0>;
};
