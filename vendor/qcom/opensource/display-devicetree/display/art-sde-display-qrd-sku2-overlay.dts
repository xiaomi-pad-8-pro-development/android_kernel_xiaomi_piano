// SPDX-License-Identifier: BSD-3-Clause
/*
 * Copyright (c) Qualcomm Technologies, Inc. and/or its subsidiaries.
 */

/dts-v1/;
/plugin/;

#include "art-sde-display-qrd.dtsi"

/ {
	model = "Qualcomm Technologies, Inc. Art QRD + Fig + ST54L + Harmonium + Pandeiro + 1s battery, Alioth";
	compatible = "qcom,art-qrd", "qcom,art", "qcom,artp-qrd", "qcom,artp",
			   "qcom,qrd";
	qcom,msm-id = <707 0x10000>, <707 0x20000>, <755 0x10000>, <755 0x20000>,
		<708 0x10000>, <708 0x20000>;
	qcom,board-id = <0x2000b 0>, <0x1002000b 0>;
};
