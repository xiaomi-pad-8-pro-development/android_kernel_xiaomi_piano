// SPDX-License-Identifier: BSD-3-Clause
/*
 * Copyright (c) Qualcomm Technologies, Inc. and/or its subsidiaries.
 */

/dts-v1/;
/plugin/;

#include "shikra-sde.dtsi"

/ {
	qcom,msm-id = <756 0x10000>, <758 0x10000>;
	qcom,board-id = <0 0>;
};
