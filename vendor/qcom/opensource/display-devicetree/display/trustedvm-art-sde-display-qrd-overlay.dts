// SPDX-License-Identifier: BSD-3-Clause
/*
 * Copyright (c) Qualcomm Technologies, Inc. and/or its subsidiaries.
 */
/dts-v1/;
/plugin/;

#include "trustedvm-art-sde.dtsi"
#include "trustedvm-art-sde-display-qrd.dtsi"

/ {
	model = "Qualcomm Technologies, Inc. Art SVM QRD";
	compatible = "qcom,art-qrd", "qcom,art", "qcom,qrd";
	qcom,msm-id = <707 0x10000>, <707 0x20000>, <708 0x10000>, <708 0x20000>;
	qcom,board-id = <11 0>;
};
