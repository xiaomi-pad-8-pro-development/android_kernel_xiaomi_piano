// SPDX-License-Identifier: BSD-3-Clause
/*
 * Copyright (c) Qualcomm Technologies, Inc. and/or its subsidiaries.
 */
/dts-v1/;
/plugin/;

#include "trustedvm-art-sde.dtsi"
#include "trustedvm-art-sde-display-cdp.dtsi"

/ {
	model = "Qualcomm Technologies, Inc. Art SVM CDP";
	compatible = "qcom,art-cdp", "qcom,art", "qcom,cdp";
	qcom,msm-id = <707 0x10000>, <707 0x20000>, <708 0x10000>, <708 0x20000>;
	qcom,board-id = <1 0>;
};
