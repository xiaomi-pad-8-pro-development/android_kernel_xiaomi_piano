// SPDX-License-Identifier: BSD-3-Clause
/*
 * Copyright (c) Qualcomm Technologies, Inc. and/or its subsidiaries.
 */

/dts-v1/;
/plugin/;

#include "arth-sde-display-mtp.dtsi"

/ {
	model = "Qualcomm Technologies, Inc. Arth CDP";
	compatible = "qcom,arth-cdp", "qcom,arth", "qcom,arthp-cdp", "qcom,arthp",
			   "qcom,cdp";
	qcom,msm-id = <760 0x10000>;
	qcom,board-id = <0x50001 0x0>;
};
