// SPDX-License-Identifier: BSD-3-Clause
/*
 * Copyright (c) Qualcomm Technologies, Inc. and/or its subsidiaries.
 */

#include "shikra.dtsi"
#include "shikra-pm8150-regulator.dtsi"
#include "shikra-pcie.dtsi"
#include "shikra-usb.dtsi"
#include "shikra-pmic-overlay-pm8150.dtsi"
#include "shikra-iqs-usb.dtsi"

/ {
	model = "Qualcomm Technologies, Inc. Shikra IQS SoC";
	compatible = "qcom,shikra-iqs";
	qcom,msm-id = <759 0x10000>;
};

&qcom_dma_heaps {
	qcom,audio {
		qcom,dma-heap-name = "qcom,audio";
		qcom,dma-heap-type = <HEAP_TYPE_CARVEOUT>;
		memory-region = <&audio_mdsp_carveout_mem>;
	};
};
