## kernel_platform/common/arch/arm64/Kconfig.debug
```kconfig
# SPDX-License-Identifier: GPL-2.0-only

config PID_IN_CONTEXTIDR
	bool "Write the current PID to the CONTEXTIDR register"
	help
	  Enabling this option causes the kernel to write the current PID to
	  the CONTEXTIDR register, at the expense of some additional
	  instructions during context switch. Say Y here only if you are
	  planning to use hardware trace tools with this kernel.

config DEBUG_EFI
	depends on EFI && DEBUG_INFO
	bool "UEFI debugging"
	help
	  Enable this option to include EFI specific debugging features into
	  the kernel that are only useful when using a debug build of the
	  UEFI firmware

config ARM64_RELOC_TEST
	depends on m
	tristate "Relocation testing module"

config PIANO_BRINGUP
	bool "Xiaomi Pad 8 Pro (piano) bring-up debug tools"
	default y # piano bring-up
	help
	  Builds the piano bring-up aids: the memcon RAM console that
	  survives a warm reset, the block-device kernel log, the
	  piano_reset_at= boot checkpoints and the extra unhandled-signal
	  reports. Test builds only; leave it off for releases.

source "drivers/hwtracing/coresight/Kconfig"
```

## kernel_platform/qcom/opensource/devicetree/bindings/android/android,firmware.yaml
```yaml
# SPDX-License-Identifier: (GPL-2.0-only OR BSD-2-Clause)
%YAML 1.2
---
$id: http://devicetree.org/schemas/android/android,firmware.yaml#
$schema: http://devicetree.org/meta-schemas/core.yaml#

title: Android Firmware

description: |
  The android,firmware node describes configuration parameters for the Android
  firmware. It is typically a child node of the top-level firmware node and
  contains sub-nodes for verified boot metadata (vbmeta) and filesystem table
  (fstab) configuration.

maintainers:
  - Sameer Sharma <samsha@qti.qualcomm.com>

properties:
  compatible:
    const: android,firmware

  boot_devices:
    $ref: /schemas/types.yaml#/definitions/string
    description:
      Comma-separated list of block device paths used for booting Android.

  vbmeta:
    type: object
    description: Verified Boot Metadata configuration node.
    properties:
      compatible:
        const: android,vbmeta
      parts:
        $ref: /schemas/types.yaml#/definitions/string
        description:
          Comma-separated list of partitions included in verified boot.
    required:
      - compatible
    additionalProperties: false

  fstab:
    type: object
    description: Filesystem table node for Android mount point definitions.
    properties:
      compatible:
        const: android,fstab
      vendor:
        type: object
        description: Android vendor partition mount configuration.
        properties:
          compatible:
            const: android,vendor
          dev:
            $ref: /schemas/types.yaml#/definitions/string
            description: Block device path for the vendor partition.
          type:
            $ref: /schemas/types.yaml#/definitions/string
            description: Filesystem type (e.g. ext4).
          mnt_flags:
            $ref: /schemas/types.yaml#/definitions/string
            description: Mount flags for the vendor partition.
          fsmgr_flags:
            $ref: /schemas/types.yaml#/definitions/string
            description: Filesystem manager flags.
          status:
            $ref: /schemas/types.yaml#/definitions/string
        required:
          - compatible
        additionalProperties: false
    required:
      - compatible
    additionalProperties: false

required:
  - compatible

additionalProperties: false

examples:
  - |
    firmware {
        android {
            compatible = "android,firmware";
            boot_devices = "vdevs/1c0f0000.virtio_blk";

            vbmeta {
                compatible = "android,vbmeta";
                parts = "vbmeta,system,vendor";
            };

            fstab {
                compatible = "android,fstab";
                vendor {
                    compatible = "android,vendor";
                    dev = "/dev/block/platform/vdevs/1c0f0000.virtio_blk/vdc";
                    type = "ext4";
                    mnt_flags = "ro,barrier=1,discard";
                    fsmgr_flags = "wait";
                    status = "disabled";
                };
            };
        };
    };
```

## kernel_platform/qcom/opensource/devicetree/bindings/hwmon/ti,ina234b.yaml
```yaml
# SPDX-License-Identifier: (GPL-2.0-only OR BSD-2-Clause)
%YAML 1.2
---
$id: http://devicetree.org/schemas/hwmon/ti,ina234b.yaml#
$schema: http://devicetree.org/meta-schemas/core.yaml#

title: Texas Instruments INA234b power/voltage monitor

maintainers:
  - Rajesh Bharathwaj <rabharat@qti.qualcomm.com>

description: |
  The INA234b is a high-side current shunt and power monitor with
  an I2C interface.

properties:
  compatible:
    enum:
      - ti,ina234b

  reg:
    maxItems: 1

required:
  - compatible
  - reg

unevaluatedProperties: false

examples:
  - |
    #include <dt-bindings/interrupt-controller/arm-gic.h>
    i2c {
      #address-cells = <1>;
      #size-cells = <0>;

      power-sensor@44 {
        compatible = "ti,ina234b";
        reg = <0x44>;
      };
    };

...
```

## kernel_platform/qcom/opensource/devicetree/bindings/i2c/renesas,slg4dc.yaml
```yaml
# SPDX-License-Identifier: (GPL-2.0-only OR BSD-2-Clause)
%YAML 1.2
---
$id: http://devicetree.org/schemas/i2c/renesas,slg4dc.yaml#
$schema: http://devicetree.org/meta-schemas/core.yaml#

title: Renesas SLG4DC Low Power Driver IC

maintainers:
  - Rajesh Bharathwaj <rabharat@qti.qualcomm.com>

properties:
  compatible:
    enum:
      - renesas,slg4dc

  reg:
    maxItems: 1

required:
  - compatible
  - reg

unevaluatedProperties: false

examples:
  - |
    #include <dt-bindings/interrupt-controller/arm-gic.h>
    i2c {
      #address-cells = <1>;
      #size-cells = <0>;

      powerdriver@04 {
        compatible = "renesas,slg4dc";
        reg = <0x04>;
      };
    };

...
```

## kernel_platform/qcom/opensource/devicetree/bindings/soc/qcom/qcom,pdr-monitor.yaml
```yaml
# SPDX-License-Identifier: (GPL-2.0-only OR BSD-2-Clause)
%YAML 1.2
---
$id: http://devicetree.org/schemas/soc/qcom/qcom,pdr-monitor.yaml#
$schema: http://devicetree.org/meta-schemas/core.yaml#

title: Qualcomm Protection Domain Restart (PDR) Monitor

maintainers:
  - Naina Mehta <nainmeht@qti.qualcomm.com>

description: |
  The PDR monitor driver provides crash monitoring and symbolized stack trace
  logging for Qualcomm DSP subsystem protection domains. It registers with the
  PDR service to receive notifications when protection domains crash and logs
  detailed crash information including symbolized stack traces.

properties:
  compatible:
    const: qcom,pdr-monitor

patternProperties:
  "^pd-":
    type: object
    description: |
      Child nodes represent individual protection domains to monitor.
      Each child node must be named with the "pd-" prefix followed by a
      descriptive identifier. Each node describes a specific PD with its
      service identifiers and SMEM configuration for crash data retrieval.

    properties:
      service-name:
        $ref: /schemas/types.yaml#/definitions/string
        description: |
          PDR service name used to register for notifications.
          Examples: "avs/audio", "tms/servreg", "kernel/elf_loader"

      service-path:
        $ref: /schemas/types.yaml#/definitions/string
        description: |
          PDR service path identifying the protection domain.
          Examples: "msm/adsp/audio_pd", "msm/cdsp/root_pd"

      qcom,smem-id:
        $ref: /schemas/types.yaml#/definitions/uint32
        description: |
          SMEM item ID containing crash stack trace data for this PD.

      qcom,smem-host:
        $ref: /schemas/types.yaml#/definitions/uint32
        description: |
          SMEM host ID for the subsystem hosting this PD.

    required:
      - service-name
      - service-path
      - qcom,smem-id
      - qcom,smem-host

    additionalProperties: false

required:
  - compatible

additionalProperties: false

examples:
  - |
    pdr_monitor {
        compatible = "qcom,pdr-monitor";

        pd-adsp-audio {
            service-name = "avs/audio";
            service-path = "msm/adsp/audio_pd";
            qcom,smem-id = <421>;
            qcom,smem-host = <1>;
        };

        pd-adsp-sensor {
            service-name = "sns/sensor";
            service-path = "msm/adsp/sensor_pd";
            qcom,smem-id = <422>;
            qcom,smem-host = <1>;
        };

        pd-cdsp-root {
            service-name = "tms/cdsp";
            service-path = "msm/cdsp/root_pd";
            qcom,smem-id = <424>;
            qcom,smem-host = <2>;
        };

        pd-wpss-root {
            service-name = "kernel/elf_loader";
            service-path = "msm/wpss/root_pd";
            qcom,smem-id = <426>;
            qcom,smem-host = <6>;
        };
    };
```
